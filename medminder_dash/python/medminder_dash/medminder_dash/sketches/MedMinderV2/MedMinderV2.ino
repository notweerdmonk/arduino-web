/* Medicine Alarm */
/* CC BY-NC-SA Jeroen Brinkman */
/* Version 2 2026-04 */
/* Arduino Nano */

#define VERSION  2

#include "RTClib.h"              // https://github.com/adafruit/RTClib
#include <TM1637TinyDisplay.h>   // https://github.com/jasonacox/TM1637TinyDisplay

// =======================================================================
// SECTION 1 — MEDICINE SCHEDULE
// Adjust whenever the medication plan changes.
// =======================================================================

// --- Alarm and display timing ---
#define LONG_PRESS_MS     2000   // Hold time (ms) required for a long press → flip display
#define STARTUP_STEP_SEC     1   // Seconds per step in the startup schedule display
#define STAP_SEC             1   // Seconds per display step: day name, date, clock and flip confirmation
#define BLINK_ON_MS        600   // ms current medicine text is visible during blink
#define BLINK_OFF_MS       400   // ms next pending medicine text is visible during blink

#define MAX_QUEUE            8   // Maximum number of medicines per queue

// --- Medicine struct ---
//
// dayOfMonth : 1-31 = specific day of the month;  0 = every day
// dayOfWeek  : 1=Mon  2=Tue  3=Wed  4=Thu  5=Fri  6=Sat  7=Sun;  0 = every day
// Both > 0   : first occurrence of dayOfWeek STRICTLY AFTER dayOfMonth in the same month
//              (the unique day d where: dayOfMonth < d <= dayOfMonth+7 and weekday(d) = dayOfWeek)
// hour       : 1-24  (use 24 for midnight 00:xx)
// decade     : 0=:00  1=:10  2=:20  3=:30  4=:40  5=:50
// text       : exactly 4 display positions
//              Double-character sequences for hard-to-render letters on 7-segment:
//                "Mm" -> M  (2 positions)   "Ww" -> W  (2 positions)
//                "nn" -> m  (2 positions)   "uu" -> w  (2 positions)
//
// Multiple medicines at the same time slot are shown one by one in specification order.

// --- alarm.hpp generated by medminder-web ---
#include "alarm.hpp"

// --- Day-name arrays (index 0 = all days, 1 = Mon ... 7 = Sun) ---
// Display strings: 4 positions, suited for 7-segment rendering
const char* const dayNamesDisp[] = {
  "ALL ",   // 0 -- all days
  "Mmo ",   // 1 -- Monday
  "tUe ",    // 2 -- Tuesday
  "WwEd",   // 3 -- Wednesday
  "thu ",   // 4 -- Thursday
  "Fri ",   // 5 -- Friday
  "Sat ",   // 6 -- Saturday
  "Sun ",   // 7 -- Sunday
  "FLIP",   // 8 -- shown on every flip
};

// Full names for the serial monitor
const char* const dayNamesFull[] = {
  "every day",   // 0
  "Monday",      // 1
  "Tuesday",     // 2
  "Wednesday",   // 3
  "Thursday",    // 4
  "Friday",      // 5
  "Saturday",    // 6
  "Sunday",      // 7
};

// =======================================================================
// SECTION 2 — HARDWARE SETTINGS
// Adjust once when assembling the hardware.
// =======================================================================

// =======================================================================
// Bootloader configuration  <- SET THIS MANUALLY
// =======================================================================
// 1: Single blink  = Arduino AVR old bootloader
// 2: Double blink  = Arduino AVR new bootloader (Optiboot)
// 3: Triple blink  = MiniCore bootloader
#define BOOTTYPE 2   // 1 = AVR old  |  2 = AVR new  |  3 = MiniCore

#if BOOTTYPE != 1
  #include <avr/wdt.h>
#endif

// --- RTC definitions ---
// Set #if condition to true for DS1307, false for DS3231
#if false   // true = DS1307  |  false = DS3231
  RTC_DS1307 rtc;
  #define NO_TIME  (!rtc.isrunning())
#else
  RTC_DS3231 rtc;
  #define NO_TIME  (rtc.lostPower())
#endif
#define USEDST       true   // Use European daylight saving time
#define THRESHOLD       2   // Max clock drift (minutes) for automatic time adjustment

// --- Pin definitions ---
#define CLK_PIN         5   // TM1637 clock pin
#define DIO_PIN         6   // TM1637 data pin
#define BUTTON          7   // Push button (connect to GND; uses internal pull-up)
#define LED            13   // On-board LED (heartbeat)

// --- Serial monitor ---
#define BAUD       115200   // Serial baud rate

// =======================================================================
// DO NOT MODIFY BELOW THIS LINE
// =======================================================================

#define StoA    1      // Standard (stored) time -> actual (local) time
#define AtoS    2      // Actual (local) time -> standard (stored) time
#define getClock()  dstClock(rtc.now(), StoA)

TM1637TinyDisplay display(CLK_PIN, DIO_PIN);

// --- State machine ---
enum AlarmState { IDLE, SHOW_INFO, ALARM, ALARM_BLINK };
AlarmState state     = IDLE;
AlarmState prevState = IDLE;

// --- Current alarm queue (medicines at the same time slot) ---
int8_t  alarmQueue[MAX_QUEUE];
uint8_t alarmCount = 0;
uint8_t alarmPos   = 0;    // index of the medicine currently shown

// --- Pending queue (medicines at a later, overdue time slot) ---
int8_t  pendingQueue[MAX_QUEUE];
uint8_t pendingCount = 0;

// --- Per-medicine "taken today" flag ---
bool    dismissed[N_MED];
uint8_t lastDay = 255;

// --- Time-slot guard: prevents re-processing the same hour + decade ---
uint8_t lastCheckedHour   = 255;
uint8_t lastCheckedDecade = 255;

// --- Button state ---
bool          btnPrevRaw        = HIGH;
bool          btnDebounced      = HIGH;
unsigned long btnDebounceStart  = 0;
bool          pressDown         = false;   // true for one loop on debounced falling edge (press)
bool          longPress         = false;   // true for one loop after LONG_PRESS_MS held
unsigned long btnPressedSince   = 0;
bool          longPressReported = false;

// --- Display ---
bool          flipped           = false;   // true = display rotated 180 degrees
bool          blinkPhase        = true;    // true = current med; false = next pending med
bool          displayDirty      = true;
unsigned long lastDisplayUpdate = 0;

// --- Info-screen sub-phases (SHOW_INFO state) ---
// 0 = day name   1 = date DD:MM   2 = clock HH:MM
uint8_t       showInfoPhase = 0;
unsigned long phaseStart    = 0;

// --- Serial ---
int      lastMinute    = -1;
int      disconnectMin = -1;
DateTime now, compiled;

// ============================================================
// SERIAL HELPER FUNCTIONS
// ============================================================

int monthToNumber(String month) {
  month.trim();
  if (month == "Jan") return 1;  if (month == "Feb") return 2;
  if (month == "Mar") return 3;  if (month == "Apr") return 4;
  if (month == "May") return 5;  if (month == "Jun") return 6;
  if (month == "Jul") return 7;  if (month == "Aug") return 8;
  if (month == "Sep") return 9;  if (month == "Oct") return 10;
  if (month == "Nov") return 11; if (month == "Dec") return 12;
  return 1;
}

DateTime parseDateTime(String dateStr, String timeStr) {
  dateStr.trim();
  while (dateStr.indexOf("  ") >= 0) dateStr.replace("  ", " ");
  int s1 = dateStr.indexOf(' ');
  int s2 = dateStr.indexOf(' ', s1 + 1);
  String mStr = dateStr.substring(0, s1);
  String dStr = dateStr.substring(s1 + 1, s2);
  String yStr = dateStr.substring(s2 + 1);
  mStr.trim(); dStr.trim(); yStr.trim();
  timeStr.trim();
  int c1 = timeStr.indexOf(':');
  int c2 = timeStr.indexOf(':', c1 + 1);
  return DateTime(yStr.toInt(), monthToNumber(mStr), dStr.toInt(),
                  timeStr.substring(0, c1).toInt(),
                  timeStr.substring(c1 + 1, c2).toInt(),
                  timeStr.substring(c2 + 1).toInt());
}

void printTime(DateTime t) {
  int d = t.dayOfTheWeek() + 20;
  if (d == 20) d = 27;
  switch (d) {
    case 21: Serial.print(F("Monday "));    break;
    case 22: Serial.print(F("Tuesday "));   break;
    case 23: Serial.print(F("Wednesday ")); break;
    case 24: Serial.print(F("Thursday "));  break;
    case 25: Serial.print(F("Friday "));    break;
    case 26: Serial.print(F("Saturday "));  break;
    case 27: Serial.print(F("Sunday "));    break;
  }
  Serial.print(t.timestamp(DateTime::TIMESTAMP_DATE));
  Serial.print(F(" "));
  Serial.print(t.timestamp(DateTime::TIMESTAMP_TIME));
}

// ============================================================
// DST AND CLOCK (unchanged from original)
// ============================================================

DateTime dstClock(DateTime n, int type) {
  DateTime b, e;
  b = DateTime(n.year(), 3, 31, 2, 0, 0);
  if (n.month() == 3) b = DateTime(n.year(), 3, 31 - b.dayOfTheWeek(), 2, 0, 0);
  e = DateTime(n.year(), 10, 31, 2, 0, 0);
  if (n.month() == 10) e = DateTime(n.year(), 10, 31 - e.dayOfTheWeek(), 2, 0, 0);
  if (USEDST) {
    if ((type == StoA) && (n >= b) && (n < e)) n = n + TimeSpan(0, 1, 0, 0); else
    if ((type == AtoS) && (n >= b) && (n < e)) n = n - TimeSpan(0, 1, 0, 0);
  }
  return n;
}

void setClock(DateTime n) {
  rtc.adjust(dstClock(n, AtoS));
}

void updateRTC() {
  now      = rtc.now();
  compiled = parseDateTime(String(__DATE__), String(__TIME__));
  compiled = dstClock(compiled, AtoS);

  bool sameDate        = (now.year()  == compiled.year())  &&
                         (now.month() == compiled.month()) &&
                         (now.day()   == compiled.day());
  long diffSeconds     = abs((long)(now.unixtime() - compiled.unixtime()));
  bool withinThreshold = diffSeconds <= ((long)THRESHOLD * 60);

  Serial.print(F("        Compile date & time: ")); printTime(compiled);
  Serial.println(F(" (standard time)"));
  Serial.print(F("    Current RTC date & time: ")); printTime(now);
  Serial.println(F(" (standard time)"));

  // If the RTC year is implausible (e.g. year 2000 after battery loss),
  // set the clock unconditionally to compile time.
  if (now.year() < 2020) {
    setClock(DateTime(F(__DATE__), F(__TIME__)));
    Serial.print(F("       RTC reset to compile: "));
    now = rtc.now();
    Serial.print(now.timestamp(DateTime::TIMESTAMP_DATE)); Serial.print(F(" "));
    Serial.print(now.timestamp(DateTime::TIMESTAMP_TIME)); Serial.println(F(" (standard time)"));
    // Recalculate for the threshold check below
    sameDate        = (now.year()  == compiled.year())  &&
                      (now.month() == compiled.month()) &&
                      (now.day()   == compiled.day());
    diffSeconds     = abs((long)(now.unixtime() - compiled.unixtime()));
    withinThreshold = diffSeconds <= ((long)THRESHOLD * 60);
  }

  if (sameDate) {
    Serial.print(F("    Delta compile vs actual: ")); Serial.print(diffSeconds);
    Serial.println(F(" seconds"));
    Serial.print(F("                  Threshold: ")); Serial.print((long)THRESHOLD * 60);
    Serial.println(F(" seconds"));
  } else {
    Serial.println(F("            Date comparison: dates do not match"));
  }
  if (sameDate && withinThreshold && (abs(diffSeconds) > 2)) {
    setClock(DateTime(F(__DATE__), F(__TIME__)));
    Serial.print(F("          Clock adjusted to: "));
    now = rtc.now();
    Serial.print(now.timestamp(DateTime::TIMESTAMP_DATE)); Serial.print(F(" "));
    Serial.print(now.timestamp(DateTime::TIMESTAMP_TIME)); Serial.println(F(" (standard time)"));
  }
  if (sameDate) {
    disconnectMin = compiled.minute() + THRESHOLD;
    disconnectMin = (disconnectMin > 59) ? disconnectMin - 60 : disconnectMin;
    Serial.print(F("   Disconnect USB at minute: ")); Serial.println(disconnectMin + 1);
  }
}

// ============================================================
// DISPLAY HELPERS
// ============================================================

// Rotate a 7-segment byte 180 degrees: a<->d, b<->e, c<->f, g unchanged.
// Segment bits: a=0x01 b=0x02 c=0x04 d=0x08 e=0x10 f=0x20 g=0x40
uint8_t flipSeg(uint8_t seg) {
  uint8_t r = seg & 0x40;       // g (middle bar) stays
  if (seg & 0x01) r |= 0x08;   // a (top)          -> d (bottom)
  if (seg & 0x08) r |= 0x01;   // d (bottom)        -> a (top)
  if (seg & 0x02) r |= 0x10;   // b (top right)     -> e (bottom left)
  if (seg & 0x10) r |= 0x02;   // e (bottom left)   -> b (top right)
  if (seg & 0x04) r |= 0x20;   // c (bottom right)  -> f (top left)
  if (seg & 0x20) r |= 0x04;   // f (top left)      -> c (bottom right)
  return r;
}

// Show text (max 4 positions), accounting for flipped display.
// NOTE: double-character sequences ("Mm"->M, "Ww"->W, "nn"->m, "uu"->w) are handled
// by showString() in the normal path, but the flipped path encodes character-by-character
// with encodeASCII() and does NOT combine them. Avoid double-char sequences in medicine
// texts if the display will be used in flipped orientation.
void showText(const char* text) {
  if (!flipped) {
    display.showString(text);
  } else {
    // Encode each character, mirror segments, reverse digit order
    uint8_t segs[4] = { 0, 0, 0, 0 };
    uint8_t len = 0;
    while (text[len] && len < 4) {
      segs[len] = display.encodeASCII(text[len]);
      len++;
    }
    uint8_t out[4] = { 0, 0, 0, 0 };
    for (uint8_t i = 0; i < len; i++)
      out[i] = flipSeg(segs[len - 1 - i]);
    display.setSegments(out, 4, 0);
  }
}

// Show the clock as HH:MM, normal or flipped.
// Flipped: digits reversed and each rotated 180 degrees; colon stays between
// physical positions 1 and 2, and reads correctly when the display is upside down.
void showClock(DateTime t) {
  uint8_t h = t.hour();
  uint8_t m = t.minute();
  uint8_t segs[4];
  if (!flipped) {
    segs[0] = (h >= 10) ? display.encodeASCII('0' + h / 10) : 0x00;  // blank leading zero
    segs[1] = display.encodeASCII('0' + h % 10) | 0x80;              // colon bit on position 1
    segs[2] = display.encodeASCII('0' + m / 10);
    segs[3] = display.encodeASCII('0' + m % 10);
  } else {
    segs[0] = flipSeg(display.encodeASCII('0' + m % 10));
    segs[1] = flipSeg(display.encodeASCII('0' + m / 10)) | 0x80;
    segs[2] = flipSeg(display.encodeASCII('0' + h % 10));
    segs[3] = (h >= 10) ? flipSeg(display.encodeASCII('0' + h / 10)) : 0x00;
  }
  display.setSegments(segs, 4, 0);
}

// Show the date as DD:MM (colon as separator), normal or flipped.
void showDate(DateTime t) {
  uint8_t d = t.day();
  uint8_t m = t.month();
  uint8_t segs[4];
  if (!flipped) {
    segs[0] = display.encodeASCII('0' + d / 10);
    segs[1] = display.encodeASCII('0' + d % 10) | 0x80;  // colon bit on position 1
    segs[2] = display.encodeASCII('0' + m / 10);
    segs[3] = display.encodeASCII('0' + m % 10);
  } else {
    segs[0] = flipSeg(display.encodeASCII('0' + m % 10));
    segs[1] = flipSeg(display.encodeASCII('0' + m / 10)) | 0x80;  // colon bit on position 1
    segs[2] = flipSeg(display.encodeASCII('0' + d % 10));
    segs[3] = flipSeg(display.encodeASCII('0' + d / 10));
  }
  display.setSegments(segs, 4, 0);
}

// ============================================================
// DAY AND TIME MATCHING
// ============================================================

// Returns true if the day of t matches the medicine specification.
// RTClib dayOfTheWeek(): 0=Sun, 1=Mon ... 6=Sat -> converted to 1=Mon ... 7=Sun.
bool isDayMatch(DateTime t, uint8_t dayOfMonth, uint8_t dayOfWeek) {
  uint8_t dow    = t.dayOfTheWeek();
  uint8_t dowMon = (dow == 0) ? 7 : dow;   // 1=Mon ... 7=Sun

  if (dayOfMonth == 0 && dayOfWeek == 0) return true;                    // every day
  if (dayOfMonth  > 0 && dayOfWeek == 0) return t.day() == dayOfMonth;   // specific date
  if (dayOfMonth == 0 && dayOfWeek  > 0) return dowMon == dayOfWeek;     // specific weekday

  // Both > 0: first occurrence of dayOfWeek strictly after dayOfMonth in the same month.
  if (dowMon != dayOfWeek) return false;
  return (t.day() > (int)dayOfMonth) && (t.day() <= (int)dayOfMonth + 7);
}

// Returns true if the current hour and decade match the specification.
bool isTimeMatch(DateTime t, uint8_t hour, uint8_t decade) {
  uint8_t h = (hour == 24) ? 0 : hour;   // 24 = midnight 00:xx
  return (t.hour() == h) && ((t.minute() / 10) == decade);
}

// ============================================================
// BUTTON: DEBOUNCE + PRESS / LONG PRESS DETECTION
// ============================================================
// pressDown : true for one loop iteration on the debounced falling edge
// longPress : true for one loop iteration once LONG_PRESS_MS has elapsed

void updateButton() {
  bool raw   = digitalRead(BUTTON);
  pressDown  = false;
  longPress  = false;

  // Debounce: require 20 ms of stable signal before acting
  if (raw != btnPrevRaw) {
    btnDebounceStart = millis();
    btnPrevRaw       = raw;
  }

  if (millis() - btnDebounceStart >= 20UL) {
    if (btnDebounced == HIGH && raw == LOW) {   // falling edge: button just pressed
      btnPressedSince   = millis();
      longPressReported = false;
      pressDown         = true;
    }
    btnDebounced = raw;
  }

  // Long press: fire once after LONG_PRESS_MS
  if (btnDebounced == LOW && !longPressReported) {
    if (millis() - btnPressedSince >= (unsigned long)LONG_PRESS_MS) {
      longPress         = true;
      longPressReported = true;
    }
  }
}

// ============================================================
// ALARM LOGIC
// ============================================================

// Check whether any medicines are now due.
// Each time slot (hour + decade combination) is processed at most once.
// Active alarm present -> new medicines added to pendingQueue -> ALARM_BLINK.
// No active alarm      -> new alarm started -> ALARM.
void checkNewAlarms(DateTime t) {
  uint8_t curDecade = t.minute() / 10;
  if (t.hour() == lastCheckedHour && curDecade == lastCheckedDecade) return;
  lastCheckedHour   = t.hour();
  lastCheckedDecade = curDecade;

  int8_t  found[MAX_QUEUE];
  uint8_t count = 0;

  for (uint8_t i = 0; i < N_MED && count < MAX_QUEUE; i++) {
    if (dismissed[i]) continue;
    if (!isTimeMatch(t, medicines[i].hour,       medicines[i].decade))     continue;
    if (!isDayMatch( t, medicines[i].dayOfMonth, medicines[i].dayOfWeek))  continue;
    found[count++] = (int8_t)i;
  }
  if (count == 0) return;

  if (state == ALARM || state == ALARM_BLINK) {
    for (uint8_t i = 0; i < count && pendingCount < MAX_QUEUE; i++)
      pendingQueue[pendingCount++] = found[i];
    state        = ALARM_BLINK;
    displayDirty = true;
  } else {
    for (uint8_t i = 0; i < count; i++) alarmQueue[i] = found[i];
    alarmCount   = count;
    alarmPos     = 0;
    state        = ALARM;
    displayDirty = true;
  }
}

// Mark the current medicine as taken and advance to the next.
// When the current queue is exhausted, promote the pending queue (if any).
// When both queues are empty, return to IDLE.
void dismissCurrent() {
  if (alarmPos < alarmCount) {
    dismissed[alarmQueue[alarmPos]] = true;
    alarmPos++;
  }
  if (alarmPos >= alarmCount) {
    if (pendingCount > 0) {
      for (uint8_t i = 0; i < pendingCount; i++) alarmQueue[i] = pendingQueue[i];
      alarmCount   = pendingCount;
      alarmPos     = 0;
      pendingCount = 0;
      state        = ALARM;
    } else {
      alarmCount = 0;
      alarmPos   = 0;
      state      = IDLE;
    }
  }
  displayDirty = true;
}

// ============================================================
// SETUP
// ============================================================

void setup() {
  Serial.begin(BAUD);
  Serial.println();
  Serial.println(F("--------- Start ---------"));
  Serial.print(F("           Software version: ")); Serial.println(VERSION);

  delay(500);    // allow RTC and I2C bus to stabilise before first communication
  rtc.begin();
  updateRTC();

  pinMode(BUTTON, INPUT_PULLUP);
  pinMode(LED,    OUTPUT);

  display.begin();
  display.setBrightness(7);   // 0 (dim) ... 7 (maximum brightness)

  // Show current day name, date and clock before the medicine schedule
  now = getClock();
  {
    uint8_t dow = now.dayOfTheWeek();
    showText(dayNamesDisp[(dow == 0) ? 7 : dow]);
    delay((unsigned long)STARTUP_STEP_SEC * 1000UL);
    showDate(now);
    delay((unsigned long)STARTUP_STEP_SEC * 1000UL);
    showClock(now);
    delay((unsigned long)STARTUP_STEP_SEC * 1000UL);
    display.clear();
    delay((unsigned long)STARTUP_STEP_SEC * 1000UL);
  }

  // Startup schedule: step through each medicine on display and serial monitor
  Serial.println();
  Serial.println(F("Startup schedule:"));
  for (uint8_t i = 0; i < N_MED; i++) {
    const Medicine& m  = medicines[i];
    uint8_t         hD = (m.hour == 24) ? 0 : m.hour;
    uint8_t         mD = m.decade * 10;
    char            buf[5];

    // Serial: full description of this medicine
    Serial.print(F("  [")); Serial.print(i); Serial.print(F("] \""));
    Serial.print(m.text); Serial.print(F("\""));
    if (m.dayOfMonth > 0 && m.dayOfWeek > 0) {
      Serial.print(F("  |  first ")); Serial.print(dayNamesFull[m.dayOfWeek]);
      Serial.print(F(" after day ")); Serial.print(m.dayOfMonth);
    } else if (m.dayOfMonth > 0) {
      Serial.print(F("  |  day ")); Serial.print(m.dayOfMonth);
    } else {
      Serial.print(F("  |  ")); Serial.print(dayNamesFull[m.dayOfWeek]);
    }
    Serial.print(F("  |  "));
    if (hD < 10) Serial.print(F("0")); Serial.print(hD);
    Serial.print(F(":"));
    if (mD < 10) Serial.print(F("0")); Serial.println(mD);

    // Step 1: day of the month — only shown if specified
    if (m.dayOfMonth > 0) {
      snprintf(buf, sizeof(buf), "d %2d", m.dayOfMonth);   // "d  1" ... "d 31"
      display.showString(buf);
      delay((unsigned long)STARTUP_STEP_SEC * 1000UL);
    }

    // Step 2: day name (or "alle" when every day)
    display.showString(dayNamesDisp[m.dayOfWeek]);
    delay((unsigned long)STARTUP_STEP_SEC * 1000UL);

    // Step 3: time H:MM or HH:MM (no leading zero)
    {
      uint8_t segs[4];
      segs[0] = (hD >= 10) ? display.encodeASCII('0' + hD / 10) : 0x00;
      segs[1] = display.encodeASCII('0' + hD % 10) | 0x80;
      segs[2] = display.encodeASCII('0' + mD / 10);
      segs[3] = display.encodeASCII('0' + mD % 10);
      display.setSegments(segs, 4, 0);
    }
    delay((unsigned long)STARTUP_STEP_SEC * 1000UL);

    // Step 4: medicine text
    display.showString(m.text);
    delay((unsigned long)STARTUP_STEP_SEC * 1000UL);

    // Step 5: blank
    display.clear();
    delay((unsigned long)STARTUP_STEP_SEC * 1000UL);
  }

  memset(dismissed, 0, sizeof(dismissed));

  #if BOOTTYPE != 1
    wdt_reset();
    wdt_enable(WDTO_8S);   // Reset if wdt_reset() is not called within 8 seconds
  #endif
}

// ============================================================
// MAIN LOOP
// ============================================================

void loop() {

  #if BOOTTYPE == 1
    digitalWrite(LED, millis() < 2000 || (millis()-2000) % 1340 < 170);
  #elif BOOTTYPE == 2
    digitalWrite(LED, millis() < 2000 || ((millis()-2000) % 1680 < 680  && (millis()-2000) % 340 < 170));
    wdt_reset();
  #elif BOOTTYPE == 3
    digitalWrite(LED, millis() < 2000 || ((millis()-2000) % 2020 < 1020 && (millis()-2000) % 340 < 170));
    wdt_reset();
  #endif

  now = getClock();

  // New day: reset "taken" flags and clear all alarm state
  if (now.day() != lastDay) {
    memset(dismissed, 0, sizeof(dismissed));
    lastDay           = now.day();
    alarmCount        = 0;
    alarmPos          = 0;
    pendingCount      = 0;
    lastCheckedHour   = 255;
    lastCheckedDecade = 255;
    state             = IDLE;
    displayDirty      = true;
  }

  updateButton();

  // Long press: flip display (active in any state)
  if (longPress) {
    flipped      = !flipped;
    Serial.print(F("Display ")); Serial.println(flipped ? F("flipped") : F("normal"));
    showText(dayNamesDisp[8]);
    #if BOOTTYPE != 1
      wdt_reset();   // prevent WDT reset during blocking delay
    #endif
    delay((unsigned long)STAP_SEC * 1000UL);
    displayDirty = true;   // force redraw of the underlying state after confirmation
  }

  checkNewAlarms(now);

  // Press down: immediate response in all states
  if (pressDown) {
    switch (state) {
      case IDLE:
        state         = SHOW_INFO;
        showInfoPhase = 0;
        phaseStart    = millis();
        displayDirty  = true;
        break;
      case SHOW_INFO:
        // Advance to the next phase; pressing again on the last phase returns to IDLE.
        // This prevents accidental cancellation when the user presses a second time
        // because they did not recognise the day name as a response.
        if (showInfoPhase < 2) {
          showInfoPhase++;
          phaseStart   = millis();
          displayDirty = true;
        } else {
          state        = IDLE;
          displayDirty = true;
        }
        break;
      case ALARM:
      case ALARM_BLINK:
        dismissCurrent();
        break;
    }
  }

  // State transition: clear display when entering IDLE
  if (state != prevState) {
    if (state == IDLE) display.clear();
    blinkPhase   = true;
    displayDirty = true;
    prevState    = state;
  }

  // SHOW_INFO: all three phases auto-advance after STAP_SEC
  if (state == SHOW_INFO) {
    if (millis() - phaseStart >= (unsigned long)STAP_SEC * 1000UL) {
      if (showInfoPhase < 2) {
        showInfoPhase++;
        phaseStart   = millis();
        displayDirty = true;
      } else {
        state        = IDLE;
        displayDirty = true;
      }
    }
  }

  // ALARM_BLINK: toggle blink phase when cycle boundary is crossed
  if (state == ALARM_BLINK) {
    unsigned long cycle    = (unsigned long)(BLINK_ON_MS + BLINK_OFF_MS);
    bool          newPhase = (millis() % cycle) < (unsigned long)BLINK_ON_MS;
    if (newPhase != blinkPhase) {
      blinkPhase   = newPhase;
      displayDirty = true;
    }
  }

  // Display update -- rate-limited to avoid saturating the I2C bus
  {
    unsigned long refreshMs;
    if (NO_TIME)  refreshMs = 500UL;          // RTC error: refresh "----" periodically
    else          refreshMs = 0xFFFFFFFFUL;   // all other states: dirty flag only

    if (displayDirty || (millis() - lastDisplayUpdate >= refreshMs)) {
      displayDirty      = false;
      lastDisplayUpdate = millis();

      if (NO_TIME) {
        display.showString("----");   // RTC error indicator
      } else {
        switch (state) {

          case IDLE:
            display.clear();   // clear any residual text (e.g. after flip confirmation)
            break;

          case SHOW_INFO:
            switch (showInfoPhase) {
              case 0: {   // Day name
                uint8_t dow = now.dayOfTheWeek();
                showText(dayNamesDisp[(dow == 0) ? 7 : dow]);   // Sun=0 -> index 7
                break;
              }
              case 1:   // Date DD:MM
                showDate(now);
                break;
              case 2:   // Clock HH:MM
                showClock(now);
                break;
            }
            break;

          case ALARM:
            if (alarmPos < alarmCount)
              showText(medicines[alarmQueue[alarmPos]].text);
            break;

          case ALARM_BLINK:
            if (blinkPhase) {
              if (alarmPos < alarmCount)
                showText(medicines[alarmQueue[alarmPos]].text);   // current medicine
            } else {
              if (pendingCount > 0)
                showText(medicines[pendingQueue[0]].text);         // next pending medicine
              else
                display.clear();
            }
            break;
        }
      }
    }
  }

  // Serial: log current time once per minute
  if (lastMinute != now.minute()) {
    printTime(now); Serial.println();
    lastMinute = now.minute();
    if (lastMinute == (disconnectMin + 1) % 60)
      Serial.println(F("Medicine alarm may be disconnected from the computer."));
  }
}
